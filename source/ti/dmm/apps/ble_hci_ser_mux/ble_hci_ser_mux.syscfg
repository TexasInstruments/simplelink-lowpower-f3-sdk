/*
 * Copyright (c) 2018, Texas Instruments Incorporated
 * All rights reserved.
 *
 * Redistribution and use in source and binary forms, with or without
 * modification, are permitted provided that the following conditions
 * are met:
 *
 * *  Redistributions of source code must retain the above copyright
 *    notice, this list of conditions and the following disclaimer.
 *
 * *  Redistributions in binary form must reproduce the above copyright
 *    notice, this list of conditions and the following disclaimer in the
 *    documentation and/or other materials provided with the distribution.
 *
 * *  Neither the name of Texas Instruments Incorporated nor the names of
 *    its contributors may be used to endorse or promote products derived
 *    from this software without specific prior written permission.
 *
 * THIS SOFTWARE IS PROVIDED BY THE COPYRIGHT HOLDERS AND CONTRIBUTORS "AS IS"
 * AND ANY EXPRESS OR IMPLIED WARRANTIES, INCLUDING, BUT NOT LIMITED TO,
 * THE IMPLIED WARRANTIES OF MERCHANTABILITY AND FITNESS FOR A PARTICULAR
 * PURPOSE ARE DISCLAIMED. IN NO EVENT SHALL THE COPYRIGHT OWNER OR
 * CONTRIBUTORS BE LIABLE FOR ANY DIRECT, INDIRECT, INCIDENTAL, SPECIAL,
 * EXEMPLARY, OR CONSEQUENTIAL DAMAGES (INCLUDING, BUT NOT LIMITED TO,
 * PROCUREMENT OF SUBSTITUTE GOODS OR SERVICES; LOSS OF USE, DATA, OR PROFITS;
 * OR BUSINESS INTERRUPTION) HOWEVER CAUSED AND ON ANY THEORY OF LIABILITY,
 * WHETHER IN CONTRACT, STRICT LIABILITY, OR TORT (INCLUDING NEGLIGENCE OR
 * OTHERWISE) ARISING IN ANY WAY OUT OF THE USE OF THIS SOFTWARE,
 * EVEN IF ADVISED OF THE POSSIBILITY OF SUCH DAMAGE.
 */

/*
 *  ble_hci_ser_mux.syscfg
 */

const lpName = system.getScript("/ti/ble/ble_common.js").getBoardOrLaunchPadName(true);

/* ======== AESCCM ======== */
var AESCCM = scripting.addModule("/ti/drivers/AESCCM");
var aesccm = AESCCM.addInstance();
aesccm.$name = "CONFIG_AESCCM0";

/* ======== AESECB ======== */
var AESECB = scripting.addModule("/ti/drivers/AESECB");
var aesecb = AESECB.addInstance();
aesecb.$name = "CONFIG_AESECB0";

/* ======== ECDH ======== */
var ECDH = scripting.addModule("/ti/drivers/ECDH");
var ecdh = ECDH.addInstance();
ecdh.$name = "CONFIG_ECDH0"

/* ======== AESCTRDRBG ======== */
var AESCTRDRBG = scripting.addModule("/ti/drivers/AESCTRDRBG");
var aesctrdrbg = AESCTRDRBG.addInstance();

/* ======== NPI UART ======== */
var UART2 = scripting.addModule("/ti/drivers/UART2");
var uart2 = UART2.addInstance();
uart2.$hardware = system.deviceData.board.components.XDS110UART;
uart2.$name = "CONFIG_UART2_0";

/* ======== RCL ======== */
const RCL = scripting.addModule("/ti/drivers/RCL");

/* ======== POWER ======== */
var Power = scripting.addModule("/ti/drivers/Power");

/* ======== RNG ======== */
var RNG = scripting.addModule("/ti/drivers/RNG");
RNG.rngReturnBehavior = "RNG_RETURN_BEHAVIOR_BLOCKING";


if (system.deviceData.deviceId.match(/CC23.*/))
{
    // Suppress warning on RNG module
    const RNG = scripting.addModule("/ti/drivers/RNG", {}, false);
    scripting.suppress("This the default noise conditioning key provided by TI, which is acceptable per NIST SP 800-90B\\. However, TI recommends you change this default value to a custom random value for your product", RNG, "noiseConditioningKeyW3");
    RNG.rngPoolSize = 512;
}


/* ======== RF Design ======== */
var rfDesign = scripting.addModule("ti/devices/radioconfig/rfdesign");
const rfDesignSettings = system.getScript("/ti/common/lprf_rf_design_settings.js").rfDesignSettings;
for(var setting in rfDesignSettings)
{
    rfDesign[setting] = rfDesignSettings[setting];
}

const radioSettings = system.getScript("/ti/ble/ble_common.js").getRadioScript(rfDesign.rfDesign,system.deviceData.deviceId);
const bleRfDesignSettings = radioSettings.rfDesignParams;
for(var setting in bleRfDesignSettings)
{
    rfDesign[setting] = bleRfDesignSettings[setting];
}

/* ======== Device ======== */
var device = scripting.addModule("ti/devices/CCFG");
const ccfgSettings = system.getScript("/ti/common/lprf_ccfg_settings.js").ccfgSettings;
for(var setting in ccfgSettings)
{
    device[setting] = ccfgSettings[setting];
}

const bleCcfgSettings = system.getScript("/ti/ble/ble_common.js").centralRoleCcfgSettings;
for(var setting in bleCcfgSettings)
{
    device[setting] = bleCcfgSettings[setting];
}




/* ======== FreeRTOS ======== */
const FreeRTOS    = scripting.addModule("/freertos/FreeRTOS");
const Settings    = scripting.addModule("/ti/posix/freertos/Settings");

FreeRTOS.heapSize         = 0x00004D50;

if (lpName.match(/CC27\d\d/))
{
    FreeRTOS.heapSize         = 0x00010000;
}
if (lpName == "LP_EM_CC2340R53")
{
    FreeRTOS.heapSize         = 0x0000A000;
}

FreeRTOS.timerStackSize       = 0x00000190;
FreeRTOS.idleStackSize        = 0x00000130;

/* For CC27XX FPGA */
if (lpName == "LP_EM_CC2755P10_FPGA" || lpName == "LP_EM_CC2745R10_FPGA")
{
    FreeRTOS.cpuFrequency = 24000000;
}

/* ======== BLE ======== */
var ble = scripting.addModule("/ti/ble/ble");
ble.deviceRole = "PERIPHERAL_CFG+CENTRAL_CFG";
ble.maxConnNum = 1;
ble.numOfAdvSets = 1;
ble.radioConfig.codeExportConfig.$name              = "ti_devices_radioconfig_code_export_param0";


/* ======== Zigbee ======== */
var zigbee  = scripting.addModule("/ti/zigbee/zigbee");
zigbee.deviceType                    = ["mac"];
zigbee.macInterface                  = "api";
zigbee.deviceTypeReadOnly            = true;
zigbee.adcNoiseEnabled               = false;
/* End of flash 0xE7000 */
zigbee.nvs.internalFlash.regionBase = 0xE6000;

/* ======== NVS BLE ======== */
var NVS = scripting.addModule("/ti/drivers/NVS");
var nvs_ble = NVS.addInstance();
nvs_ble.internalFlash.regionBase   = 0xE3000;
nvs_ble.internalFlash.regionSize   = 0x3000;
nvs_ble.$name = "CONFIG_NVSINTERNAL";

const dmm          = scripting.addModule("/ti/dmm/dmm");
dmm.stackRoles                   = ["zigbeeEndDevice","blePeripheral"];
dmm.policyArray[0].$name         = "ti_dmm_policy_dmm_policy0";
dmm.policyArray[0].zigbeeEndDevice.$name = "ti_dmm_policy_stack_dmm_stack_custom0";
dmm.policyArray[0].blePeripheral.$name = "ti_dmm_policy_stack_dmm_stack_custom1";

/* Temporary Workaround for Core SDK 9.20.00.04 */
const CryptoKeyKeyStore_PSA = scripting.addModule("/ti/drivers/CryptoKeyKeyStore_PSA");
CryptoKeyKeyStore_PSA.flashRegionType = "Pointer";
