# CC27x0 register map
File version: 1.0
CC27x0 Family of Devices
CPU: CM4 r0p4, little endian, no MPU, no FPU, VTOR, 3 interrupt priority bits
Registers are 32-bit, read-write, reset 0x0 unless marked. A register's access mark holds for its fields unless they carry their own. Offsets are from the block's base; lines under a group give offsets from that group; [hi:lo] are bit positions; {n}, {i} and the like mark numbered series; 'fields as' and 'values as' point back to an identical list; <NAME> marks a mode.

## Memory map
0x00000000 FLASH_MAIN size 0x100000
0x0F000000 ROM size 0x8000
0x20000000 SRAM size 0x28800
0x40000000 PMCTL size 0x1000 — This component is the Power Management controller. Together with the System Controller, it controls system resets and the power states of the device.
0x40001000 CKMD size 0x1000 — Clock Controller
0x40002000 RTC size 0x1000 — ULL Real Time Clock module RTC includes 2 channels. - Channel 0 is a compare channel - Channel 1 is a capture channel
0x40003000 IOC size 0x1000 — IO Controller
0x40004000 SYS0 size 0x1000 — This is top module of SYS0
0x40005000 EVTULL size 0x1000 — This is top module of Event Fabric for LOKI
0x40006000 PMUD size 0x1000 — Digital control signals for VDDR regulator and Battery Monitor
0x40007000 TCM size 0x1000 — IO Controller
0x4000F000 DBGSS size 0x1000
0x40020000 CLKCTL size 0x1000 — This component is the clock controller. Here SW can turn on and off IP clocks and read IP and system clock status.
0x40021000 FLASH size 0x1000 — This is the MMR space for the flash wrapper. The flash wrapper is targeting multiple microcontroller platforms. The flash wrapper is a module that manages complex flash read, program and erase memory operations. The system is also given direct access to read flash memory contents directly for each instantiated flash bank through FBAP ports.
0x40022000 SYSTIM size 0x1000 — SVT System Timer Module
0x40023000 GPIO size 0x1000 — MCU GPIO - I/F for controlling and reading IO status and IO event status
0x40024000 VIMS size 0x1000 — Versatile Instruction Memory System Controls memory access to the Flash and encapsulates the following instruction memories: - Boot ROM - Caches
0x40025000 EVTSVT size 0x1000 — This is top module of Event Fabric for LOKI
0x40030000 SPI0 size 0x1000 — Serial Peripheral Interface (SPI) module with peripheral and controller capabilities.
0x40031000 SPI1 size 0x1000 — Serial Peripheral Interface (SPI) module with peripheral and controller capabilities.
0x40034000 UART0 size 0x1000 — Universal Asynchronous Receiver/Transmitter (UART) interface
0x40035000 UART1 size 0x1000 — Universal Asynchronous Receiver/Transmitter (UART) interface
0x40038000 I2C0 size 0x1000 — I2C IP module with peripheral and controller capabilities
0x40050000 ADC size 0x1000 — ADC (Analog to Digital Converter) module
0x40053000 HSM size 0x1000 — HSM is a Root of Trust Engine that protects valuable assets, such as secret keys for embedded security sensitive applications in a Trusted Execution Environment
0x40060000 LGPT0 size 0x1000 — This component is a general purpose timer. The timer offers - generation of waveforms and events. - capture of signal period and duty cycle. - generation of IR signals. - decoding of quadrature encoded signals. - motor control features. It consists of a - 16-bit counter. - 8-bit prescaler - 3 capture compare channels. - 3 event outputs. - 3 capture inputs. Each channel subscribes to the synchronous event bus. They can control one or more event outputs in both capture and compare modes. PRECFG.TICKSRC selects tick source for the timer.
0x40061000 LGPT1 size 0x1000 — This component is a general purpose timer. The timer offers - generation of waveforms and events. - capture of signal period and duty cycle. - generation of IR signals. - decoding of quadrature encoded signals. - motor control features. It consists of a - 16-bit counter. - 8-bit prescaler - 3 capture compare channels. - 3 event outputs. - 3 capture inputs. Each channel subscribes to the synchronous event bus. They can control one or more event outputs in both capture and compare modes. PRECFG.TICKSRC selects tick source for the timer.
0x40062000 LGPT2 size 0x1000 — This component is a general purpose timer. The timer offers - generation of waveforms and events. - capture of signal period and duty cycle. - generation of IR signals. - decoding of quadrature encoded signals. - motor control features. It consists of a - 16-bit counter. - 8-bit prescaler - 3 capture compare channels. - 3 event outputs. - 3 capture inputs. Each channel subscribes to the synchronous event bus. They can control one or more event outputs in both capture and compare modes. PRECFG.TICKSRC selects tick source for the timer.
0x40063000 LGPT3 size 0x1000 — This component is a general purpose timer. The timer offers - generation of waveforms and events. - capture of signal period and duty cycle. - generation of IR signals. - decoding of quadrature encoded signals. - motor control features. It consists of a - 16-bit counter. - 8-bit prescaler - 3 capture compare channels. - 3 event outputs. - 3 capture inputs. Each channel subscribes to the synchronous event bus. They can control one or more event outputs in both capture and compare modes. PRECFG.TICKSRC selects tick source for the timer.
0x40080000 LRFDDBELL size 0x1000
0x40081000 LRFDPBE size 0x400
0x40081400 LRFDPBE32 size 0x400
0x40081800 LRFDTXF size 0x400
0x40081C00 LRFDRXF size 0x400
0x40082000 LRFDMDM size 0x400
0x40082400 LRFDMDM32 size 0x400
0x40083000 LRFDRFE size 0x400
0x40083400 LRFDRFE32 size 0x400
0x40084000 LRFDTRC size 0x1000
0x40085000 LRFDS2R size 0x1000
0x40090000 LRFD_PBERAM size 0x1000
0x40092000 LRFD_BUFRAM size 0x600
0x40094000 LRFD_MCERAM size 0x800
0x40096000 LRFD_RFERAM size 0x1000
0x400C0000 AES size 0x1000 — The AES-128 crypto peripheral accellerates AES-128 block cipher encryption and decryption. The peripheral does also offer hardware features to accellerate cipher modes implemented in software: * CBC-MAC * CBC * CTR * CFB * OFB * PCBC The module provides two data registers that can be input to AES operation. These are termed TXT and BUF. TXT is the AES-128 work buffer, and content changes during an AES operation. Software cannot update TXT during an ongoing AES operation. BUF is an auxiliary 128-bit buffer with multiple purposes: * initialization vector(IV) storage * counter in CTR cipher mode * hold next value of TXT Software can update BUF during an AES operation. This allows software to write next TXT during an ongoing AES operation and hence save AES idle times.
0x400C1000 I2S size 0x1000 — I2S Audio DMA module supporting formats I2S, LJF, RJF and DSP
0x400C4000 DMA size 0x1000 — ARM Micro Direct Memory Access Controller
0x400C5000 SRAMCTRL size 0x1000 — System SRAM Controller
0x400D0000 CANFD size 0x2000 — IPXACT generated on 6/2/2017 at 11:21 by the IPXCEL-to-IPXACT Converter Script v3.1
0x400D1000 CANFD_SRAM size 0x1000
0x400D2000 APU size 0x4000 — The APU - Algorithm Processing Unit - is a generic mathematical acceleration module that is able to operate with single-precision floating point numbers (IEEE 754 format) and is optimized to work with complex numbers.
0x400D3000 APU_TOPSMRAM size 0x1000
0x400E0000 APURAM_DATA0 size 0x2000
0x400E2000 APURAM_DATA1 size 0x2000
0x400F0000 HSMCRYPTO size 0x10000 — HSM is a Root of Trust Engine that protects valuable assets, such as secret keys for embedded security sensitive applications in a Trusted Execution Environment
0x4E000000 FCFG size 0x400
0x4E020000 CCFG size 0x800
0x4E020800 OTP size 0x800
0x4E040000 SCFG size 0x400
0x4E060000 VLOG size 0x800
0x4E060800 OTP_BKP size 0x800
0xE0002000 FPB size 0x1000
0xE000E000 ICB size 0x10
0xE000E010 SYSTICK size 0x10
0xE000ED90 MPU size 0x40
0xE000EDD0 SAU size 0x20
0xE000EDE0 DCB size 0x10
0xE000EF30 FPE size 0x20
0xE000EFB0 DIB size 0x80
0xE0040000 TPIU size 0x1000 — Cortex-M's Trace Port Interface Unit (TPIU)
0xE00FF000 CPU_ROM_TABLE size 0x1000

## Interrupts
0 CPUIRQ0 (EVTSVT)
1 CPUIRQ1 (EVTSVT)
2 CPUIRQ2 (EVTSVT)
3 CPUIRQ3 (EVTSVT)
4 CPUIRQ4 (EVTSVT)
5 GPIO_COMB (EVTSVT)
6 LRFD_IRQ0 (EVTSVT)
7 LRFD_IRQ1 (EVTSVT)
8 DMA_DONE_COMB (EVTSVT)
9 AES_COMB (EVTSVT)
10 SPI0_COMB (EVTSVT)
11 UART0_COMB (EVTSVT)
12 I2C0_IRQ (EVTSVT)
13 LGPT0_COMB (EVTSVT)
14 LGPT1_COMB (EVTSVT)
15 ADC_COMB (EVTSVT)
16 CPUIRQ16 (EVTSVT)
17 CPUIRQ17 (EVTSVT)
18 LGPT2_COMB (EVTSVT)
19 LGPT3_COMB (EVTSVT)
20 I2S_IRQ (EVTSVT)
21 CAN_IRQ (EVTSVT)
22 UART1_COMB (EVTSVT)
23 SPI1_COMB (EVTSVT)
24 APU_IRQ (EVTSVT)
25 HSM_SEC_IRQ (EVTSVT)
26 HSM_NONSEC_IRQ (EVTSVT)
27 HSM_OTP_IRQ (EVTSVT)
28 AON_PMU_COMB (EVTSVT)
29 AON_CKM_COMB (EVTSVT)
30 AON_RTC_COMB (EVTSVT)
31 AON_LPMCMP_IRQ (EVTSVT)
32 AON_IOC_COMB (EVTSVT)
