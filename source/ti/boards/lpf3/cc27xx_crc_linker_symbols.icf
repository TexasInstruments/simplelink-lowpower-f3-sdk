/*
 * This file contains the same symbols generated by GenMaps and SysConfig,
 * intended to make the device-specific F3 linker files compatible with the
 * CRC tool.
 */

define exported symbol ti_utils_build_GenMap_sym_CRC_CCFG_BOOT_CFG_begin = 0x4e020000;
define exported symbol ti_utils_build_GenMap_sym_CRC_CCFG_BOOT_CFG_end = 0x4e02000b;
define exported symbol ti_utils_build_GenMap_sym_CRC_CCFG_begin = 0x4e020010;
define exported symbol ti_utils_build_GenMap_sym_CRC_CCFG_end = 0x4e02074b;
define exported symbol ti_utils_build_GenMap_sym_CRC_CCFG_DEBUG_begin = 0x4e0207d0;
define exported symbol ti_utils_build_GenMap_sym_CRC_CCFG_DEBUG_end = 0x4e0207fb;
define exported symbol ti_utils_build_GenMap_sym_CRC_SCFG_begin = 0x4e040000;
define exported symbol ti_utils_build_GenMap_sym_CRC_SCFG_end = 0x4e0400e3;
define exported symbol ti_utils_build_GenMap_sym_CRC_CCFG_USER_RECORD_begin = 0x4e020750;
define exported symbol ti_utils_build_GenMap_sym_CRC_CCFG_USER_RECORD_end = 0x4e0207cb;