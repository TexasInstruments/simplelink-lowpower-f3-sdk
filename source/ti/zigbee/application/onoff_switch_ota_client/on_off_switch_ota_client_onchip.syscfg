/*
 * Copyright (c) 2020-2021, Texas Instruments Incorporated
 * All rights reserved.
 *
 * Redistribution and use in source and binary forms, with or without
 * modification, are permitted provided that the following conditions
 * are met:
 *
 * *  Redistributions of source code must retain the above copyright
 *    notice, this list of conditions and the following disclaimer.
 *
 * *  Redistributions in binary form must reproduce the above copyright
 *    notice, this list of conditions and the following disclaimer in the
 *    documentation and/or other materials provided with the distribution.
 *
 * *  Neither the name of Texas Instruments Incorporated nor the names of
 *    its contributors may be used to endorse or promote products derived
 *    from this software without specific prior written permission.
 *
 * THIS SOFTWARE IS PROVIDED BY THE COPYRIGHT HOLDERS AND CONTRIBUTORS "AS IS"
 * AND ANY EXPRESS OR IMPLIED WARRANTIES, INCLUDING, BUT NOT LIMITED TO,
 * THE IMPLIED WARRANTIES OF MERCHANTABILITY AND FITNESS FOR A PARTICULAR
 * PURPOSE ARE DISCLAIMED. IN NO EVENT SHALL THE COPYRIGHT OWNER OR
 * CONTRIBUTORS BE LIABLE FOR ANY DIRECT, INDIRECT, INCIDENTAL, SPECIAL,
 * EXEMPLARY, OR CONSEQUENTIAL DAMAGES (INCLUDING, BUT NOT LIMITED TO,
 * PROCUREMENT OF SUBSTITUTE GOODS OR SERVICES; LOSS OF USE, DATA, OR PROFITS;
 * OR BUSINESS INTERRUPTION) HOWEVER CAUSED AND ON ANY THEORY OF LIABILITY,
 * WHETHER IN CONTRACT, STRICT LIABILITY, OR TORT (INCLUDING NEGLIGENCE OR
 * OTHERWISE) ARISING IN ANY WAY OUT OF THE USE OF THIS SOFTWARE,
 * EVEN IF ADVISED OF THE POSSIBILITY OF SUCH DAMAGE.
 */

/*
 *  on_off_switch.syscfg
 */

/* ======== Kernel Configuration ======== */
system.getScript("kernel_config_release.syscfg.js");

/* ======== GPIO ======== */
const GPIO = scripting.addModule("/ti/drivers/GPIO");  // Add a GPIO module for use by buttons

/* ======== LED ======== */
const LED = scripting.addModule("/ti/drivers/GPIO");
const LED_G = LED.addInstance();

/* if a green LED component exists, assign it to the LED_G instance */
if (system.deviceData.board && system.deviceData.board.components.LED_GREEN) {
    LED_G.$hardware = system.deviceData.board.components.LED_GREEN;
}
else
{
    LED_G.mode = "Output";   // Set the LED pin to output
}

LED_G.$name = "CONFIG_GPIO_GLED"; // Descriptive name for the LED_G GPIO

const LED_R = LED.addInstance();

/* if a red LED component exists, assign it to the LED_R instance */
if (system.deviceData.board && system.deviceData.board.components.LED_RED) {
    LED_R.$hardware = system.deviceData.board.components.LED_RED;
}
else
{
    LED_R.mode = "Output";   // Set the LED pin to output
}

LED_R.$name = "CONFIG_GPIO_RLED";

/* ======== Left Button ======== */
const BUTTON_L = GPIO.addInstance();                      // Add an a GPIO module instance for BUTTON_L

/* if a BUTTON0 component exists, assign it to the BUTTON_L instance */
if (system.deviceData.board && system.deviceData.board.components.BUTTON0) {
    BUTTON_L.$hardware = system.deviceData.board.components.BUTTON0;
}

BUTTON_L.mode = "Input";                              // Change the GPIO to Input mode
BUTTON_L.$name = "CONFIG_GPIO_BTN1";                  // Descriptive name for the BUTTON_L GPIO
BUTTON_L.pull = "Pull Up";                            // Use Pull up resistor
BUTTON_L.interruptTrigger = "Falling Edge";           // GPIO Interrupt Trigger

/* ======== Right Button ======== */
const BUTTON_R = GPIO.addInstance();                      // Add an a GPIO module instance for BUTTON_R

/* if a BUTTON0 component exists, assign it to the BUTTON_R instance */
if (system.deviceData.board && system.deviceData.board.components.BUTTON1) {
    BUTTON_R.$hardware = system.deviceData.board.components.BUTTON1;
}

BUTTON_R.mode = "Input";                              // Change the GPIO to Input mode
BUTTON_R.$name = "CONFIG_GPIO_BTN2";                  // Descriptive name for the BUTTON_R GPIO
BUTTON_R.pull = "Pull Up";                            // Use Pull up resistor
BUTTON_R.interruptTrigger = "Falling Edge";           // GPIO Interrupt Trigger

/* ======== Device ======== */
var device = scripting.addModule("ti/devices/CCFG");
const ccfgSettings = system.getScript("/ti/common/lprf_ccfg_settings.js").ccfgSettings;
for(var setting in ccfgSettings)
{
    device[setting] = ccfgSettings[setting];
}

/* ======== Zigbee ======== */

var zigbee  = scripting.addModule("/ti/zigbee/zigbee");
zigbee.deviceType                    = ["zed"];
zigbee.deviceTypeReadOnly            = false;

if(system.deviceData.deviceId.match(/CC23.*/))
{
    // Suppress warning on RNG module
    const RNG = scripting.addModule("/ti/drivers/RNG", {}, false);
    scripting.suppress("This the default noise conditioning key provided by TI, which is acceptable per NIST SP 800-90B\\. However, TI recommends you change this default value to a custom random value for your product", RNG, "noiseConditioningKeyW3");
    RNG.rngPoolSize = 512;
}

if(system.getRTOS() === "freertos")
{
    /* ======== FreeRTOS ======== */
    const FreeRTOS = scripting.addModule("/freertos/FreeRTOS");
    FreeRTOS.heapSize = 0x00001BBC;
    FreeRTOS.idleStackSize = 512;
    FreeRTOS.timerStackSize = 256;
}

/* ======== RF Design ======== */
var rfDesign = scripting.addModule("ti/devices/radioconfig/rfdesign");
const rfDesignSettings = system.getScript("/ti/common/lprf_rf_design_settings.js").rfDesignSettings;
for(var setting in rfDesignSettings)
{
    rfDesign[setting] = rfDesignSettings[setting];
}
/* ======== OTA On-Chip Flash Layout ========
 * MCUBoot (overwrite mode) uses two flash slots:
 *   - Primary slot:   running application (flashed at appBase)
 *   - Secondary slot: OTA download staging area (NVS1 / CONFIG_NVSINTERNAL1)
 *
 * The build produces 3 signed images (see ExampleList.js):
 *   _ota_1st_slot.bin  - Padded to slot size. Flash this at appBase via UniFlash.
 *   _ota_2nd_slot.bin  - Padded to slot size. For direct secondary slot testing.
 *   _ota_nopad.bin     - Unpadded (~220KB). Use this for OTA file generation:
 *
 *       zOTAfileGen <name>_ota_nopad.bin <output_dir> BEBE 2340 <version_hex>
 *
 *     The version must be GREATER than the client's file_version in the .c file.
 *     Load the resulting .zigbee file on the Z-Stack OTA server.
 *
 * IMPORTANT: Do NOT use _ota_2nd_slot.bin for zOTAfileGen on devices with large
 * slots (e.g., CC2755P20 at 896KB). OTA .zigbee files >= 512KB fail during
 * discovery. Always use _ota_nopad.bin for OTA transfers.
 *
 * Memory maps per device (MCUBoot overwrite mode, appBase=0x4000):
 *
 *   CC23xx (1M Low+):
 *     Primary: 0x7000,  Slot: 0x46000, Secondary: 0x4D000, NVS_ZB: auto
 *
 *   CC2755P10 (1M High):
 *     Primary: 0x4000,  Slot: 0x60000, Secondary: 0x87000, NVS_ZB: 0xE7000
 *
 *   CC2755P20 (2M High):
 *     Primary:   0x4000  → 0xE4000  (0xE0000, Bank 0)
 *     GAP:       0xE4000 → 0x100000 (0x1C000, Bank 0 unused)
 *     Secondary: 0x100000→ 0x1E0000 (0xE0000, all Bank 1) ← critical: avoids Bank0/Bank1 write conflict
 *     NVS_ZB:    0x1E7000→ 0x1E8000 (4KB, auto-placed, no overlap)
 *     HSM:       0x1E8000→ 0x200000 (96KB)
 *     MCUBoot must match: primarySize1=0xE0000, secondaryBase1=0x100000, secondarySize1=0xE0000
 */
if(system.deviceData.deviceId.match(/CC23.*/))
{
    /* ======== Internal Flash for Image Slot 2 ======== */
    const NVS      = scripting.addModule("/ti/drivers/NVS", {}, false);
    const NVS2       = NVS.addInstance();
    NVS2.$name                    = "CONFIG_NVSINTERNAL1";
    NVS2.internalFlash.$name      = "ti_drivers_nvs_NVSLPF30";
    NVS2.internalFlash.regionType = "Pointer";
    NVS2.internalFlash.regionBase = 0x4D000;
    NVS2.internalFlash.regionSize = 0x32000;

    /* ======== MCUBoot App======== */
    const mcuboot_app  = scripting.addModule("/ti/common/mcuboot_application");
    mcuboot_app.imageCompression         = true;
    mcuboot_app.appBase                  = 0x00007000;
    mcuboot_app.appSlotSize              = 0x00046000;
    mcuboot_app.appSlotSizeCompressed    = 0x00032000;
}
else if(system.deviceData.deviceId.match(/CC2755P20.*/))
{
    /* ======== CC27xx 2M: Internal Flash for Image Slot 2 ========
     *
     * Layout:
     *   MCUBoot    16 KB   0x000000 – 0x003FFF
     *   Primary   896 KB   0x004000 – 0x0E3FFF  (Bank 0, entirely)
     *   GAP       112 KB   0x0E4000 – 0x0FFFFF  (Bank 0 unused — unavoidable)
     *   Secondary 896 KB   0x100000 – 0x1DFFFF  (Bank 1, entirely)
     *   FREE       28 KB   0x1E0000 – 0x1E6FFF
     *   NVS_ZB      4 KB   0x1E7000 – 0x1E7FFF  (auto-placed)
     *   HSM        96 KB   0x1E8000 – 0x1FFFFF
     *
     * Secondary is entirely in Bank 1 — NVS_write() never crosses 0x100000.
     * NVSLPF3 driver does not support writes spanning Bank 0/Bank 1 boundary
     * (cross-bank NVS_write returns NVS_STATUS_ERROR — see coresdk_lpf3 bug).
     *
     * BOOT_MAGIC at: 0x100000 + 0xE0000 - 16 = 0x1DFFF0
     *
     * MCUBoot syscfg (sccm package) must match:
     *   primarySize1   = 0xE0000
     *   secondaryBase1 = 0x100000
     *   secondarySize1 = 0xE0000
     */
    const NVS      = scripting.addModule("/ti/drivers/NVS", {}, false);
    const NVS2       = NVS.addInstance();
    NVS2.$name                    = "CONFIG_NVSINTERNAL1";
    NVS2.internalFlash.$name      = "ti_drivers_nvs_NVSLPF30";
    NVS2.internalFlash.regionType = "Pointer";
    NVS2.internalFlash.regionBase = 0x100000;
    NVS2.internalFlash.regionSize = 0xE0000;

    /* ======== MCUBoot App ======== */
    const mcuboot_app  = scripting.addModule("/ti/common/mcuboot_application");
    mcuboot_app.imageCompression         = false;
    mcuboot_app.appBase                  = 0x00004000;
    mcuboot_app.appSlotSize              = 0x000E0000;
    mcuboot_app.appSlotSizeCompressed    = 0x000E0000;
}
else
{
    /* ======== CC27xx 1M: Internal Flash for Image Slot 2 ======== */
    const NVS      = scripting.addModule("/ti/drivers/NVS", {}, false);
    const NVS2       = NVS.addInstance();
    NVS2.$name                    = "CONFIG_NVSINTERNAL1";
    NVS2.internalFlash.$name      = "ti_drivers_nvs_NVSLPF30";
    NVS2.internalFlash.regionType = "Pointer";
    NVS2.internalFlash.regionBase = 0x87000;
    NVS2.internalFlash.regionSize = 0x60000;

    /* ======== MCUBoot App======== */
    const mcuboot_app  = scripting.addModule("/ti/common/mcuboot_application");
    mcuboot_app.imageCompression         = false;
    mcuboot_app.appBase                  = 0x00004000;
    mcuboot_app.appSlotSize              = 0x00060000;
    mcuboot_app.appSlotSizeCompressed    = 0x00060000;
}
